## conf/layer.conf
```bitbake
#We have a conf and classes directory, add to BBPATH
BBPATH .= ":${LAYERDIR}"

# We have recipes-* directories, add to BBFILES
BBFILES += "${LAYERDIR}/recipes-*/*/*.bb \
	${LAYERDIR}/recipes-*/*/*.bbappend"

BBFILE_COLLECTIONS += "meta-rwt-carbon808-cardf"
BBFILE_PATTERN_meta-rwt-carbon808-cardf = "^${LAYERDIR}/"
BBFILE_PRIORITY_meta-rwt-carbon808-cardf = "9"

LAYERSERIES_COMPAT_meta-rwt-carbon808-cardf = "kirkstone"
```
